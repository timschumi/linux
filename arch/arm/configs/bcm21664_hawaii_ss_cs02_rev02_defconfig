## arch/arm/configs/hawaii_defconfig
```kconfig
# CONFIG_USELIB is not set
CONFIG_AUDIT=y
CONFIG_NO_HZ=y
CONFIG_HIGH_RES_TIMERS=y
CONFIG_TASKSTATS=y
CONFIG_TASK_DELAY_ACCT=y
CONFIG_TASK_XACCT=y
CONFIG_TASK_IO_ACCOUNTING=y
CONFIG_IKCONFIG=y
CONFIG_IKCONFIG_PROC=y
CONFIG_CGROUPS=y
CONFIG_CGROUP_FREEZER=y
CONFIG_CGROUP_CPUACCT=y
CONFIG_RESOURCE_COUNTERS=y
CONFIG_CGROUP_SCHED=y
CONFIG_RT_GROUP_SCHED=y
CONFIG_BLK_DEV_INITRD=y
CONFIG_KALLSYMS_ALL=y
CONFIG_EMBEDDED=y
CONFIG_PROFILING=y
CONFIG_CC_STACKPROTECTOR_STRONG=y
CONFIG_MODULES=y
CONFIG_MODULE_UNLOAD=y
CONFIG_MODVERSIONS=y
CONFIG_ARCH_BCM=y
CONFIG_ARCH_BCM_MOBILE=y
CONFIG_ARM_KERNMEM_PERMS=y
CONFIG_PREEMPT=y
CONFIG_KSM=y
CONFIG_SECCOMP=y
CONFIG_BUILD_ARM_APPENDED_DTB_IMAGE=y
CONFIG_BUILD_ARM_APPENDED_DTB_IMAGE_NAMES="bcm21664-hawaii"
CONFIG_ARM_APPENDED_DTB=y
CONFIG_CMDLINE="earlyprintk=serial,ttyS0,115200n8 console=ttyS0,115200n8"
# CONFIG_CORE_DUMP_DEFAULT_ELF_HEADERS is not set
CONFIG_PM_WAKELOCKS=y
CONFIG_PM_WAKELOCKS_LIMIT=0
# CONFIG_PM_WAKELOCKS_GC is not set
CONFIG_PM_RUNTIME=y
CONFIG_PM_DEBUG=y
CONFIG_SUSPEND_TIME=y
CONFIG_NET=y
CONFIG_PACKET=y
CONFIG_UNIX=y
CONFIG_XFRM_USER=y
CONFIG_NET_KEY=y
CONFIG_INET=y
CONFIG_IP_MULTICAST=y
CONFIG_IP_ADVANCED_ROUTER=y
CONFIG_IP_MULTIPLE_TABLES=y
CONFIG_NET_IPVTI=y
CONFIG_INET_ESP=y
# CONFIG_INET_LRO is not set
CONFIG_INET_DIAG_DESTROY=y
CONFIG_IPV6=y
CONFIG_IPV6_ROUTER_PREF=y
CONFIG_IPV6_ROUTE_INFO=y
CONFIG_IPV6_OPTIMISTIC_DAD=y
CONFIG_INET6_ESP=y
CONFIG_INET6_IPCOMP=y
CONFIG_IPV6_MIP6=y
CONFIG_IPV6_VTI=y
CONFIG_IPV6_MULTIPLE_TABLES=y
CONFIG_NETFILTER=y
CONFIG_NF_CONNTRACK=y
CONFIG_NF_CONNTRACK_SECMARK=y
CONFIG_NF_CONNTRACK_EVENTS=y
CONFIG_NF_CT_PROTO_DCCP=y
CONFIG_NF_CT_PROTO_SCTP=y
CONFIG_NF_CT_PROTO_UDPLITE=y
CONFIG_NF_CONNTRACK_AMANDA=y
CONFIG_NF_CONNTRACK_FTP=y
CONFIG_NF_CONNTRACK_H323=y
CONFIG_NF_CONNTRACK_IRC=y
CONFIG_NF_CONNTRACK_NETBIOS_NS=y
CONFIG_NF_CONNTRACK_PPTP=y
CONFIG_NF_CONNTRACK_SANE=y
CONFIG_NF_CONNTRACK_TFTP=y
CONFIG_NF_CT_NETLINK=y
CONFIG_NETFILTER_XT_TARGET_CLASSIFY=y
CONFIG_NETFILTER_XT_TARGET_CONNMARK=y
CONFIG_NETFILTER_XT_TARGET_CONNSECMARK=y
CONFIG_NETFILTER_XT_TARGET_IDLETIMER=y
CONFIG_NETFILTER_XT_TARGET_MARK=y
CONFIG_NETFILTER_XT_TARGET_NFLOG=y
CONFIG_NETFILTER_XT_TARGET_NFQUEUE=y
CONFIG_NETFILTER_XT_TARGET_TPROXY=y
CONFIG_NETFILTER_XT_TARGET_TRACE=y
CONFIG_NETFILTER_XT_TARGET_SECMARK=y
CONFIG_NETFILTER_XT_TARGET_TCPMSS=y
CONFIG_NETFILTER_XT_MATCH_COMMENT=y
CONFIG_NETFILTER_XT_MATCH_CONNLIMIT=y
CONFIG_NETFILTER_XT_MATCH_CONNMARK=y
CONFIG_NETFILTER_XT_MATCH_CONNTRACK=y
CONFIG_NETFILTER_XT_MATCH_HASHLIMIT=y
CONFIG_NETFILTER_XT_MATCH_HELPER=y
CONFIG_NETFILTER_XT_MATCH_IPRANGE=y
CONFIG_NETFILTER_XT_MATCH_LENGTH=y
CONFIG_NETFILTER_XT_MATCH_LIMIT=y
CONFIG_NETFILTER_XT_MATCH_MAC=y
CONFIG_NETFILTER_XT_MATCH_MARK=y
CONFIG_NETFILTER_XT_MATCH_POLICY=y
CONFIG_NETFILTER_XT_MATCH_PKTTYPE=y
CONFIG_NETFILTER_XT_MATCH_QTAGUID=y
CONFIG_NETFILTER_XT_MATCH_QUOTA=y
CONFIG_NETFILTER_XT_MATCH_QUOTA2=y
CONFIG_NETFILTER_XT_MATCH_SOCKET=y
CONFIG_NETFILTER_XT_MATCH_STATE=y
CONFIG_NETFILTER_XT_MATCH_STATISTIC=y
CONFIG_NETFILTER_XT_MATCH_STRING=y
CONFIG_NETFILTER_XT_MATCH_TIME=y
CONFIG_NETFILTER_XT_MATCH_U32=y
CONFIG_NF_CONNTRACK_IPV4=y
CONFIG_IP_NF_IPTABLES=y
CONFIG_IP_NF_MATCH_ECN=y
CONFIG_IP_NF_MATCH_TTL=y
CONFIG_IP_NF_FILTER=y
CONFIG_IP_NF_TARGET_REJECT=y
CONFIG_IP_NF_NAT=y
CONFIG_IP_NF_TARGET_MASQUERADE=y
CONFIG_IP_NF_TARGET_NETMAP=y
CONFIG_IP_NF_TARGET_REDIRECT=y
CONFIG_IP_NF_MANGLE=y
CONFIG_IP_NF_RAW=y
CONFIG_IP_NF_SECURITY=y
CONFIG_IP_NF_ARPTABLES=y
CONFIG_IP_NF_ARPFILTER=y
CONFIG_IP_NF_ARP_MANGLE=y
CONFIG_NF_CONNTRACK_IPV6=y
CONFIG_IP6_NF_IPTABLES=y
CONFIG_IP6_NF_MATCH_RPFILTER=y
CONFIG_IP6_NF_FILTER=y
CONFIG_IP6_NF_TARGET_REJECT=y
CONFIG_IP6_NF_MANGLE=y
CONFIG_IP6_NF_RAW=y
CONFIG_NET_SCHED=y
CONFIG_NET_SCH_HTB=y
CONFIG_NET_CLS_U32=y
CONFIG_NET_EMATCH=y
CONFIG_NET_EMATCH_U32=y
CONFIG_NET_CLS_ACT=y
CONFIG_BLK_DEV_LOOP=y
CONFIG_BLK_DEV_RAM=y
CONFIG_BLK_DEV_RAM_SIZE=8192
CONFIG_UID_STAT=y
CONFIG_UID_SYS_STATS=y
CONFIG_MEMORY_STATE_TIME=y
CONFIG_MD=y
CONFIG_BLK_DEV_DM=y
CONFIG_DM_CRYPT=y
CONFIG_DM_UEVENT=y
CONFIG_DM_VERITY=y
CONFIG_DM_VERITY_FEC=y
CONFIG_NETDEVICES=y
CONFIG_TUN=y
CONFIG_PPP=y
CONFIG_PPP_BSDCOMP=y
CONFIG_PPP_DEFLATE=y
CONFIG_PPP_MPPE=y
CONFIG_PPPOLAC=y
CONFIG_PPPOPNS=y
CONFIG_USB_USBNET=y
CONFIG_INPUT_EVDEV=y
CONFIG_INPUT_KEYRESET=y
# CONFIG_INPUT_MOUSE is not set
CONFIG_INPUT_JOYSTICK=y
CONFIG_JOYSTICK_XPAD=y
CONFIG_JOYSTICK_XPAD_FF=y
CONFIG_JOYSTICK_XPAD_LEDS=y
CONFIG_INPUT_TABLET=y
CONFIG_TABLET_USB_ACECAD=y
CONFIG_TABLET_USB_AIPTEK=y
CONFIG_TABLET_USB_GTCO=y
CONFIG_TABLET_USB_HANWANG=y
CONFIG_TABLET_USB_KBTAB=y
CONFIG_INPUT_MISC=y
CONFIG_INPUT_UINPUT=y
CONFIG_INPUT_GPIO=y
# CONFIG_VT is not set
# CONFIG_LEGACY_PTYS is not set
# CONFIG_DEVMEM is not set
# CONFIG_DEVKMEM is not set
CONFIG_MEDIA_SUPPORT=y
CONFIG_BACKLIGHT_LCD_SUPPORT=y
CONFIG_SOUND=y
CONFIG_SND=y
CONFIG_HIDRAW=y
CONFIG_UHID=y
CONFIG_HID_A4TECH=y
CONFIG_HID_ACRUX=y
CONFIG_HID_ACRUX_FF=y
CONFIG_HID_APPLE=y
CONFIG_HID_BELKIN=y
CONFIG_HID_CHERRY=y
CONFIG_HID_CHICONY=y
CONFIG_HID_PRODIKEYS=y
CONFIG_HID_CYPRESS=y
CONFIG_HID_DRAGONRISE=y
CONFIG_DRAGONRISE_FF=y
CONFIG_HID_EMS_FF=y
CONFIG_HID_ELECOM=y
CONFIG_HID_EZKEY=y
CONFIG_HID_HOLTEK=y
CONFIG_HID_KEYTOUCH=y
CONFIG_HID_KYE=y
CONFIG_HID_UCLOGIC=y
CONFIG_HID_WALTOP=y
CONFIG_HID_GYRATION=y
CONFIG_HID_TWINHAN=y
CONFIG_HID_KENSINGTON=y
CONFIG_HID_LCPOWER=y
CONFIG_HID_LOGITECH=y
CONFIG_HID_LOGITECH_DJ=y
CONFIG_LOGITECH_FF=y
CONFIG_LOGIRUMBLEPAD2_FF=y
CONFIG_LOGIG940_FF=y
CONFIG_HID_MAGICMOUSE=y
CONFIG_HID_MICROSOFT=y
CONFIG_HID_MONTEREY=y
CONFIG_HID_MULTITOUCH=y
CONFIG_HID_NTRIG=y
CONFIG_HID_ORTEK=y
CONFIG_HID_PANTHERLORD=y
CONFIG_PANTHERLORD_FF=y
CONFIG_HID_PETALYNX=y
CONFIG_HID_PICOLCD=y
CONFIG_HID_PRIMAX=y
CONFIG_HID_ROCCAT=y
CONFIG_HID_SAITEK=y
CONFIG_HID_SAMSUNG=y
CONFIG_HID_SONY=y
CONFIG_HID_SPEEDLINK=y
CONFIG_HID_SUNPLUS=y
CONFIG_HID_GREENASIA=y
CONFIG_GREENASIA_FF=y
CONFIG_HID_SMARTJOYPLUS=y
CONFIG_SMARTJOYPLUS_FF=y
CONFIG_HID_TIVO=y
CONFIG_HID_TOPSEED=y
CONFIG_HID_THRUSTMASTER=y
CONFIG_HID_WACOM=y
CONFIG_HID_WIIMOTE=y
CONFIG_HID_ZEROPLUS=y
CONFIG_HID_ZYDACRON=y
CONFIG_USB_HIDDEV=y
CONFIG_USB_ANNOUNCE_NEW_DEVICES=y
CONFIG_USB_EHCI_HCD=y
CONFIG_USB_GADGET=y
CONFIG_SWITCH=y
CONFIG_RTC_CLASS=y
CONFIG_STAGING=y
CONFIG_ANDROID=y
CONFIG_ANDROID_BINDER_IPC=y
CONFIG_ASHMEM=y
CONFIG_ANDROID_TIMED_GPIO=y
CONFIG_SYNC=y
CONFIG_ION=y
CONFIG_EXT4_FS=y
CONFIG_EXT4_FS_SECURITY=y
CONFIG_QUOTA=y
CONFIG_QUOTA_NETLINK_INTERFACE=y
CONFIG_QFMT_V2=y
CONFIG_FUSE_FS=y
CONFIG_MSDOS_FS=y
CONFIG_VFAT_FS=y
CONFIG_TMPFS=y
CONFIG_TMPFS_POSIX_ACL=y
CONFIG_CONFIGFS_FS=y
CONFIG_SDCARD_FS=y
CONFIG_PSTORE=y
CONFIG_PSTORE_CONSOLE=y
CONFIG_PSTORE_RAM=y
CONFIG_MAGIC_SYSRQ=y
CONFIG_PANIC_TIMEOUT=5
CONFIG_SCHEDSTATS=y
CONFIG_TIMER_STATS=y
CONFIG_ENABLE_DEFAULT_TRACERS=y
CONFIG_DEBUG_LL=y
CONFIG_DEBUG_UART_PHYS=0x3e002000
CONFIG_EARLY_PRINTK=y
CONFIG_EARLY_PRINTK_DIRECT=y
CONFIG_KEYS=y
CONFIG_SECURITY_PERF_EVENTS_RESTRICT=y
CONFIG_SECURITY=y
CONFIG_SECURITY_NETWORK=y
CONFIG_HARDENED_USERCOPY=y
CONFIG_SECURITY_SELINUX=y
CONFIG_CRYPTO_GCM=y
CONFIG_CRYPTO_SHA256=y
CONFIG_CRYPTO_SHA512=y
CONFIG_ASYMMETRIC_KEY_TYPE=y
CONFIG_ASYMMETRIC_PUBLIC_KEY_SUBTYPE=y
CONFIG_X509_CERTIFICATE_PARSER=y
CONFIG_PKCS7_MESSAGE_PARSER=y
CONFIG_PKCS7_TEST_KEY=y
```

## arch/arm/mach-hawaii/Kconfig
```kconfig
menu	"Hawaii SoC based Machine types"
	depends on ARCH_HAWAII

choice
	prompt "Choose Hawaii SOC Silicon Version"
	default ARCH_HAWAII_A0

config	ARCH_HAWAII_A0
	bool "Hawaii SOC Version - A0"

endchoice

choice
	prompt "Hawaii SoC based board type"
	default y

config	MACH_HAWAII_SS_CS02_REV00
	bool "Support Broadcom Hawaii SS cs02 board"
	help
	  Support for the Broadcom Hawaii SS cs02 board.
	  Assumes that MACH_HAWAII_SS_CS02 is also set.
	  
config	MACH_HAWAII_SS_CS02_REV01
	bool "Support Broadcom Hawaii SS cs02 board"
	help
	  Support for the Broadcom Hawaii SS cs02 board.
	  Assumes that MACH_HAWAII_SS_CS02 is also set.	  
	  
config	MACH_HAWAII_SS_CS02_REV02
	bool "Support Broadcom Hawaii SS cs02 board"
	help
	  Support for the Broadcom Hawaii SS cs02 board.
	  Assumes that MACH_HAWAII_SS_CS02 is also set.
endchoice

config	MACH_HAWAII_SS_COMMON
	bool "Support Broadcom Hawaii SS Common Features"
	default n
	help
	  Support for the Broadcom Hawaii SS Common Features.
	  Use of this configuration option has been depricated
	  and will be removed in the next release.  Prior to removal
	  need to veriy that the customer is no longer using it.

config	MACH_HAWAII_SS_CS02
	bool "Support Broadcom Hawaii Samsung CS02 board"
	default n
	help
	  Support for the Broadcom Hawaii Samsung CS02 board.

config	IGNORE_DAP_POWERUP_REQ
	bool "Ignore Powerup request from DAP"
	depends on KONA_POWER_MGR
	default n
	help
	  Say Y to ignore powerup request from DAP. So, the power domains will
	  continue to be in their state. If this is not set, on attaching JTAG
	  PI policy will change to 7 always. This feature enables the system to
	  retain the states as is, even after attaching JTAG.

config	HAWAII_L2X0_PREFETCH
	bool "Enable L2 cache prefetching for Hawaii platform"
	default n
	help
	  Say Y if you want to enable L2 cache prefetching
	  for the Hawaii platform. This enables both, data and
	  instruction prefetching that have been shown to improve
	  performance especially in multimedia use cases.

config	DELAYED_PM_INIT
	depends on ARCH_HAWAII
	bool "Enable support for delayed PM init."
	default n
	help
	  Say Y if you want to enable support for delayed PM init. Android/user
	  space can complete the PM init by writing to sysfs. Once this trigger
	  is recieved, all the PIs start changing policies, arm can enter LPM and
	  arm dfs is allowed.

config	PWRMGR_1P2GHZ_OPS_SET_SELECT
	depends on ARCH_HAWAII && KONA_POWER_MGR && KONA_CPU_FREQ_ENABLE_OPP_SET_CHANGE
	bool "Reconfigure the pll for OPS set with Turbo at 1.2GHz"
	default n
	help
	  Say Y if you want to reconfigure the pll for Turbo at 1.2G. All other
	  ops gets adjusted accordingly. If this is not selected,
	  default OPP set is with Turbo at 1GHz.

config	PI_MGR_MM_STURBO_ENABLE
	depends on ARCH_HAWAII && KONA_PI_MGR
	bool "Enable super turbo OPP for MM Power Island"
	default n
	help
	  Say Y to enable super turbo DFS OPP for MM power Island
	  MM super turbo OPP frequency is set to 312MHz. Total 4
	  OPPs will be defined for MM if the support is enabled

config	PWRMGR_DUMMY_SEQUENCER
	bool "Use dummy PWRMGR HW I2C sequencer"
	default n
	help
	  Say Y if you want to use dummy PWRMGR HW I2C sequencer

config	KONA_PMU_BSC_CLKPAD_CTRL
	bool "Kona PMU_BSC CLKPAD Control feature"
	depends on MFD_BCM_PWRMGR_SW_SEQUENCER
	default y
	help
	   Enable to save the leakage current due to BSC CLKPAD. If enabled
	   Sequencer will disable the PMU BSC CLK pad at the end of each
	   i2c transaction which will save the leakage current on the pad pi

config MM_V3D_TIMEOUT_ERRATUM
	bool "Enable MM V3D timeout erratum workaround"
	default y
	help
	 Say Y to enable MM V3D timeout(HWHAWAII-207) workaround
	 Refer JIRA DB for more info

config PLL1_8PHASE_OFF_ERRATUM
	bool "Enable workaround for PLL1 8phase off erratum"
	default y
	help
	 Say Y to enable workaround for PLL1 8phase off erratum (HWHAWAII-73)
	 Refer JIRA DB for more info

config MM_POWER_OK_ERRATUM
	bool "Enable MM power ok mask erratum workaround"
	default y
	help
	 Say Y to enable workaround for MM power ok mask erratum(HWRHEA-2272)
	 Refer JIRA DB for more info

config MM_FREEZE_VAR500M_ERRATUM
	bool "Disable autogating for Varvdd500M clock to resolve MM freeze"
	default y
	help
	 Say Y to enable workaround for MM freeze with varvdd500 autogating
	 enabled erratum(HWHAWAII-73)
	 Refer JIRA DB for more info

config	HAWAIILC_2093
	bool "Enable HawaiiLC&2093"
	default n
        help
           Enable HawaiiLC&2093.

config	PI_MGR_DISABLE_POLICY_CHANGE
	bool "Enable debug flag to disable PI policy change by default"
	depends on KONA_PI_MGR
	default n
	help
	  Debug flag to diable PI policy change by default. All PI
	  policy will be set to wakeup policy 7

config KONA_AVS
       bool "Enable AVS driver"
       help
	Say Y if you want to enable AVS driver
	AVS driver helps pick the correct voltage table
	by identifying the silicon type thereby saving
	power by giving only reqd voltage & not excess.

config	CDEBUGGER
	depends on ARCH_HAWAII
	bool "Enable Ramdump dump Feature on Hawaii"
	default n

config	59055_SIM_EM_SHDWN
	bool "Enable Emergency SIM shutdown"
	default n
	help
	  For 59055 supported emergency sim shutdown

config	MACH_HAWAII_SS_EMMC_EXTLDO
	bool "Enable SS EMMC external LDO"
	default y
	help
	  For SS EMMC memory external LDO

config CPU_SYSPLL_WFI_CSTATE
	bool "Enable CPU WFI idle state using system PLL"
	default n
	help
	 Option to enable special ARM WFI cpuidle state.
	 PROC policy is changed to use FID 0-4 which comes
	 from system PLL when all the cores are in this
	 state. This way, ARM internal PLL can be turned
	 off to save power.

config	A9_RETENTION_CSTATE
	bool "Turn ON A9 retention state"
	default n
	help
	  Option to enable A9 retention state for cpuidle. A9 retention
	  results in A9 domain voltage being lowered, resulting in better
	  power savings during idle.

config A9_DORMANT_MODE
       bool "Enable A9 dormant state"
       default n
       help
         Option to enable A9 dormant state for cpuidle and suspend. A9 dormant
         mode results in A9 domain voltage being shutoff, resulting in better
         power savings during idle.

config  DSM_IN_SUSPEND_ONLY
	bool "Allow system deep sleep only in suspend"
	default n
	help
	 Option to enable deep sleep only in linux suspend case and do
	 not allow system deep sleep in cpu idle case. This means as
	 long as system is not in suspended, device will not enter
	 deep sleep

config KONA_SECURE_MONITOR_CALL
	bool "Execute in non-secure mode using Kona secure monitor"
	default y
	help
	  Select this option if you are running with a bootloader that
	  has configured the ARM to run in non-secure mode and provides
	  a secure monitor implementation to access secure registers
	  and peripherals.

config HAWAII_PTM
	bool "Enable PTM"
	depends on ARCH_KONA
	select ARM_AMBA
	select OC_ETM
	help
	  Say Y here to enable PTM hardware on hawaii.

config BRD_NAME
	string "customer board name"
	default "hawaii"

config BCM_HWCAPRI_1605_A2
	bool "Enable HWCAPRI_1605 workaround"
	default n
	help
	  Enable HWCAPRI_1605 workaround
	  to set L2 divider to 2 for normal
	  case should be 3 wait for ASIC fix
	  Refer JIRA DB for more infor on this
	  JIRA
endmenu
```
